## CMakeLists.txt
```
# Copyright (c) The ThingSet Project Contributors
# SPDX-License-Identifier: Apache-2.0

cmake_minimum_required(VERSION 3.13.1)
find_package(Zephyr REQUIRED HINTS $ENV{ZEPHYR_BASE})

project(thingset_zds2023)

target_include_directories(app PRIVATE src)

target_sources(app PRIVATE src/main.c)
```

## prj.conf
```kconfig
# Copyright (c) The ThingSet Project Contributors
# SPDX-License-Identifier: Apache-2.0

CONFIG_LOG=y
CONFIG_LOG_MODE_MINIMAL=y

CONFIG_I2C=y
CONFIG_SENSOR=y

CONFIG_PICOLIBC=y
CONFIG_PICOLIBC_IO_FLOAT=y

## ThingSet Library & SDK #####################################################

CONFIG_THINGSET=y
CONFIG_THINGSET_SDK=y
CONFIG_THINGSET_NODE_NAME="Smart Thermostat"

## ThingSet Shell #############################################################

CONFIG_SHELL=y

# Avoid conflicts with ThingSet ? command
CONFIG_SHELL_WILDCARD=n

# Support `select thingset` to run ThingSet requests directly
CONFIG_SHELL_CMDS_SELECT=y

CONFIG_THINGSET_SHELL=y
CONFIG_THINGSET_SHELL_REPORTING=n

## ThingSet Storage ###########################################################

CONFIG_FLASH=y
CONFIG_FLASH_PAGE_LAYOUT=y
CONFIG_NVS=y

# Required for MCUs with enabled MPU
CONFIG_MPU_ALLOW_FLASH_WRITE=y

CONFIG_THINGSET_STORAGE=y

## ThingSet Bluetooth #########################################################

CONFIG_BT=y
CONFIG_BT_PERIPHERAL=y
CONFIG_BT_DEVICE_NAME="ZDS 2023 Sensor"
CONFIG_BT_DEVICE_NAME_DYNAMIC=y
CONFIG_BT_GATT_CLIENT=y

# Increase buffer sizes to allow long ATT values
CONFIG_BT_BUF_ACL_RX_SIZE=251
CONFIG_BT_BUF_ACL_TX_SIZE=251
CONFIG_BT_L2CAP_TX_MTU=251

CONFIG_THINGSET_BLE=y
```

## src/main.c
```c
/*
 * Copyright (c) The ThingSet Project Contributors
 *
 * SPDX-License-Identifier: Apache-2.0
 */

#include <zephyr/device.h>
#include <zephyr/drivers/gpio.h>
#include <zephyr/drivers/sensor.h>
#include <zephyr/kernel.h>
#include <zephyr/logging/log.h>

#include <thingset.h>
#include <thingset/sdk.h>

#include <stdio.h>

#define APP_ID_SENSOR          0x05
#define APP_ID_SENSOR_TEMP     0x50
#define APP_ID_SENSOR_HUMIDITY 0x51

#define APP_ID_CONTROL             0x06
#define APP_ID_CONTROL_HEATER_ON   0x60
#define APP_ID_CONTROL_TARGET_TEMP 0x61

static float room_temp;
static float humidity;
static float target_temp = 22.0F;
static bool heater_on;

static const struct device *sensor = DEVICE_DT_GET_ONE(bosch_bme680);
static const struct gpio_dt_spec led = GPIO_DT_SPEC_GET(DT_ALIAS(led0), gpios);

static void control_change_callback(enum thingset_callback_reason reason);

THINGSET_ADD_GROUP(TS_ID_ROOT, APP_ID_SENSOR, "Sensor", THINGSET_NO_CALLBACK);

THINGSET_ADD_ITEM_FLOAT(APP_ID_SENSOR, APP_ID_SENSOR_TEMP, "rRoomTemp_degC", &room_temp, 1,
                        THINGSET_ANY_R, TS_SUBSET_LIVE);

THINGSET_ADD_ITEM_FLOAT(APP_ID_SENSOR, APP_ID_SENSOR_HUMIDITY, "rHumidity_pct", &humidity, 1,
                        THINGSET_ANY_R, TS_SUBSET_LIVE);

THINGSET_ADD_GROUP(TS_ID_ROOT, APP_ID_CONTROL, "Control", control_change_callback);

THINGSET_ADD_ITEM_BOOL(APP_ID_CONTROL, APP_ID_CONTROL_HEATER_ON, "rHeaterOn", &heater_on,
                       THINGSET_ANY_R, TS_SUBSET_LIVE);

THINGSET_ADD_ITEM_FLOAT(APP_ID_CONTROL, APP_ID_CONTROL_TARGET_TEMP, "sTargetTemp_degC",
                        &target_temp, 1, THINGSET_ANY_RW, TS_SUBSET_NVM);

static void run_controller()
{
    if (room_temp < target_temp) {
        heater_on = true;
        gpio_pin_set_dt(&led, 1);
    }
    else {
        heater_on = false;
        gpio_pin_set_dt(&led, 0);
    }
}

static void control_change_callback(enum thingset_callback_reason reason)
{
    if (reason == THINGSET_CALLBACK_POST_WRITE) {
        run_controller();
    }
}

int main(void)
{
    struct sensor_value sval;

    if (!device_is_ready(sensor) || !gpio_is_ready_dt(&led)) {
        printf("Sensor or LED not ready\n");
        return -ENODEV;
    }

    gpio_pin_configure_dt(&led, GPIO_OUTPUT_ACTIVE);

    while (true) {
        sensor_sample_fetch(sensor);

        sensor_channel_get(sensor, SENSOR_CHAN_AMBIENT_TEMP, &sval);
        room_temp = sensor_value_to_float(&sval);

        sensor_channel_get(sensor, SENSOR_CHAN_HUMIDITY, &sval);
        humidity = sensor_value_to_float(&sval);

        run_controller();

        k_sleep(K_MSEC(5000));
    }

    return 0;
}
```
